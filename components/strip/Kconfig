## components/strip/Kconfig
```kconfig
menu "Led strips"

config MAX_LEDS_COUNT
        int "The greatest leds on any strip"
        default 250
        help
                Length of the greatest strip in the system.

endmenu
```

## main/Kconfig.projbuild
```kconfig
menu "ColdHands Configuration"

menu "Hands strip"

config HAND_LEDS_COUNT
        int "Number of leds in hand strip"
        default 50
        help
                Number of leds to turn on.

config HAND_SPI_INVERT
        bool "Invert signals in hand strip"
        default y
        help
                Enable if clock and data signals go through an inverter.

config HAND_SPI_MHZ
        int "Hand strip SPI speed in MHz"
        default 10
        help
                SPI speed in MHz.

config HAND_SPI_SCLK
        int "Hand strip CI port"
        default 21
        help
                CLK GPIO pin for leds.

config HAND_SPI_MOSI
        int "Hand strip DI port"
        default 22
        help
                MOSI GPIO pin for leds.

endmenu

menu "Heart strip"

config HEART_LEDS_COUNT
        int "Number of leds in heart strip"
        default 50
        help
                Number of leds to turn on.

config HEART_SPI_INVERT
        bool "Invert signals in heart strip"
        default y
        help
                Enable if clock and data signals go through an inverter.

config HEART_SPI_MHZ
        int "Heart strip SPI speed in MHz"
        default 10
        help
                SPI speed in MHz.

config HEART_SPI_SCLK
        int "Heart strip CI port"
        default 27
        help
                CLK GPIO pin for leds.

config HEART_SPI_MOSI
        int "Heart strip DI port"
        default 26
        help
                MOSI GPIO pin for leds.

endmenu

endmenu
```
